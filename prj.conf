## CMakeLists.txt
```
#
# Copyright (c) 2020 Nordic Semiconductor
#
# SPDX-License-Identifier: LicenseRef-Nordic-5-Clause
#

cmake_minimum_required(VERSION 3.20.0)

find_package(Zephyr REQUIRED HINTS $ENV{ZEPHYR_BASE})
project(milo_fw)

# NORDIC SDK APP START
add_subdirectory(src)
# NORDIC SDK APP END

zephyr_include_directories(src)
zephyr_include_directories(config)
```

## Kconfig
```
menu "WiFi Provisioning Sample"

config WIFI_PROV_ADV_DATA_UPDATE
	bool "Enable periodic update of advertisement data"
	default y

if WIFI_PROV_ADV_DATA_UPDATE

	config WIFI_PROV_ADV_DATA_UPDATE_INTERVAL
		int "Periodic update interval in second"
		default 5

endif # WIFI_PROV_ADV_DATA_UPDATE

endmenu

menu "Zephyr Kernel"
source "Kconfig.zephyr"
endmenu


module = MILO_FW
module-str = Milo firmware
source "${ZEPHYR_BASE}/subsys/logging/Kconfig.template.log_config"

module = APPLAYER_WIFI_PROV
module-str = APPLAYER wifi provisioning module
source "${ZEPHYR_BASE}/subsys/logging/Kconfig.template.log_config"

module = APPLAYER_MEMFAULT
module-str = APPLAYER_MEMFAULT
source "${ZEPHYR_BASE}/subsys/logging/Kconfig.template.log_config"
```

## sample.yaml
```
sample:
  description: Minimal Zephyr configuration sample that only suspends CPU.
  name: Empty firmware for application core
tests:
  sample.nrf5340.empty_app_core.build:
    build_only: true
    integration_platforms:
      - nrf7002dk_nrf5340_cpuapp
    platform_allow: nrf7002dk_nrf5340_cpuapp
    tags: ci_build
```

## prj.conf
```kconfig
# ------- Driver Enabling  ------- #
# ------- End of Driver Enabling  ------- #


CONFIG_POSIX_MAX_FDS=12
CONFIG_NET_CONFIG_AUTO_INIT=y

# Networking Management AP

# Actif: Added from the Diff provided by Nordic
# I need to question about NET_OFFLOAD impact
CONFIG_NET_CONFIG_INIT_TIMEOUT=0 

CONFIG_NET_OFFLOAD=y

# CONFIG_NET_SOCKETS_SOCKOPT_TLS=y # Already in board config
CONFIG_NET_SOCKETS_POLL_MAX=16


# Actif: This is usally new to us, we will need more guidance on the impact.
CONFIG_COMMON_LIBC_MALLOC=y
CONFIG_COMMON_LIBC_MALLOC_ARENA_SIZE=32768
```

## boards/nrf7002dk_nrf5340_cpuapp.conf
```kconfig
# General
CONFIG_NEWLIB_LIBC=y
CONFIG_NEWLIB_LIBC_NANO=n
CONFIG_POSIX_CLOCK=y
CONFIG_HW_STACK_PROTECTION=y
CONFIG_HW_ID_LIBRARY=y
CONFIG_HW_ID_LIBRARY_SOURCE_NET_MAC=y

CONFIG_DK_LIBRARY=y
CONFIG_ENTROPY_GENERATOR=y

# Activated with the debug overlay
CONFIG_SHELL=n
CONFIG_CONSOLE=n
CONFIG_LOG=n

# Heap and stacks
CONFIG_INIT_STACKS=y
CONFIG_STACK_SENTINEL=y

CONFIG_HEAP_MEM_POOL_SIZE=140000
CONFIG_MAIN_STACK_SIZE=8192
CONFIG_SYSTEM_WORKQUEUE_STACK_SIZE=4096
CONFIG_SHELL_STACK_SIZE=4096
CONFIG_NET_TX_STACK_SIZE=4096
CONFIG_NET_RX_STACK_SIZE=4096

CONFIG_NET_TCP_WORKQ_STACK_SIZE=2048

# Networking Management API
CONFIG_NET_MGMT=y
CONFIG_NET_MGMT_EVENT_STACK_SIZE=4096

CONFIG_NET_MGMT_EVENT=y
CONFIG_NET_MGMT_EVENT_INFO=y
CONFIG_WIFI_MGMT_EXT=y
# Actif: Kept enabled since it seem this was not the error cause
CONFIG_NET_CONNECTION_MANAGER=y

# Networking
CONFIG_NETWORKING=y
CONFIG_NET_SOCKETS=y
CONFIG_NET_IPV6=n
CONFIG_NET_IPV4=y
CONFIG_NET_SOCKETS=y
CONFIG_NET_UDP=y
CONFIG_NET_TCP=y
CONFIG_NET_DHCPV4=y
CONFIG_DNS_RESOLVER=y

CONFIG_NET_L2_ETHERNET=y
CONFIG_NET_L2_WIFI_MGMT=y
CONFIG_NET_SOCKETS_OFFLOAD=n
CONFIG_NET_CONTEXT_SNDTIMEO=y
CONFIG_NET_SOCKETS_SOCKOPT_TLS=y
CONFIG_NET_STATISTICS=n
CONFIG_NET_STATISTICS_WIFI=y
CONFIG_NET_STATISTICS_USER_API=y
CONFIG_NET_MAX_CONTEXTS=5
CONFIG_NET_CONTEXT_SYNC_RECV=y
CONFIG_NET_NATIVE=y


# printing of scan results puts pressure on queues in new locking
# design in net_mgmt. So, use a typical number of networks in a crowded
# environment as the queue depth.
CONFIG_NET_MGMT_EVENT_QUEUE_SIZE=150


# Wi-Fi
# https://developer.nordicsemi.com/nRF_Connect_SDK/doc/latest/nrf/device_guides/working_with_nrf/nrf70/developing/constrained.html
CONFIG_WIFI=y
CONFIG_WIFI_NRF700X=y

CONFIG_WPA_SUPP=y
CONFIG_WPA_SUPP_LOG_LEVEL_OFF=y

# Storing credentials
CONFIG_FLASH=y
CONFIG_FLASH_PAGE_LAYOUT=y
CONFIG_FLASH_MAP=y
CONFIG_STREAM_FLASH=y

CONFIG_NVS=y

CONFIG_SETTINGS=y
CONFIG_SETTINGS_NVS=y

# Enable the necessary Wi-Fi credential configurations
CONFIG_WIFI_CREDENTIALS=y
CONFIG_WIFI_CREDENTIALS_MAX_ENTRIES=1
CONFIG_WIFI_CREDENTIALS_BACKEND_SETTINGS=y
# CONFIG_WIFI_CREDENTIALS_STATIC=y
# CONFIG_WIFI_CREDENTIALS_STATIC_SSID="ORBI70"
# CONFIG_WIFI_CREDENTIALS_STATIC_PASSWORD="classyocean724"

# Native network stack
CONFIG_NRF_SECURITY=y
CONFIG_PSA_CRYPTO_DRIVER_CC3XX=n
CONFIG_MBEDTLS=y
CONFIG_MBEDTLS_ENABLE_HEAP=y
CONFIG_MBEDTLS_HEAP_SIZE=120000
CONFIG_MBEDTLS_RSA_C=y
CONFIG_MBEDTLS_SSL_SERVER_NAME_INDICATION=y

# The sample enables flash storage for coredumps, which depend on the parition manager.
# By default, nRF7002DK builds are for a single image, so the partition manager must be enabled
# also for single image builds.
CONFIG_PM_SINGLE_IMAGE=y

# Zephyr NET Connection Manager Connectivity layer.
CONFIG_L2_WIFI_CONNECTIVITY=y
CONFIG_L2_WIFI_CONNECTIVITY_AUTO_CONNECT=n
CONFIG_L2_WIFI_CONNECTIVITY_AUTO_DOWN=n

CONFIG_NET_CONNECTION_MANAGER_MONITOR_STACK_SIZE=4096
```

## boards/nrf7002dk_nrf5340_cpuapp.overlay
```dts
// To get started, press Ctrl+Space to bring up the completion menu and view the available nodes.

// You can also use the buttons in the sidebar to perform actions on nodes.
// Actions currently available include:

// * Enabling / disabling the node
// * Adding the bus to a bus
// * Removing the node
// * Connecting ADC channels

// For more help, browse the DeviceTree documentation at https://docs.zephyrproject.org/latest/guides/dts/index.html
// You can also visit the nRF DeviceTree extension documentation at https://nrfconnect.github.io/vscode-nrf-connect/devicetree/nrfdevicetree.html
&usbd {
    status = "disabled";
};
```

## src/main.c
```c
/** @file main.c
 *   @brief Milo nRF5340 application core main application
 */

#include <zephyr/kernel.h>
#include <stdio.h>
#include <dk_buttons_and_leds.h>

#include <zephyr/logging/log.h>
#include <zephyr/logging/log_ctrl.h>

#include "wifi_provisioning/wifi_prov.h"
#include "memfault/memfault.h"

LOG_MODULE_REGISTER(milo_main, CONFIG_MILO_FW_LOG_LEVEL);

int main(void)
{
    /* Sleep 1 seconds to allow initialization of wifi driver. */
    // It is everywhere in Nordic example, we will keep it since we don't have a good reason to remove it.
    k_sleep(K_SECONDS(1));

    start_wifi_provisioning_service();
    k_yield();
    start_memfault();
    while (1)
    {
        LOG_INF("Looping main");
        k_yield();
    }
    return 0;
}
```
